## config/west.yml
```yaml
manifest:
  defaults:
    revision: v0.3
  remotes:
  - name: zmkfirmware
    url-base: https://github.com/zmkfirmware
    # Additional modules containing boards/shields/custom code can be listed here as well
    # See https://docs.zephyrproject.org/3.2.0/develop/west/manifest.html#projects
  - name: jlw # You can name this whatever you like; just make sure the "remote" below matches.
    url-base: https://github.com/josh-l-wang
  projects:
  - name: zmk
    remote: zmkfirmware
    import: app/west.yml
  - name: le-chiffre-stm32
    url: https://github.com/petejohanson/le-chiffre-stm32-zmk-config/
    revision: main
    path: modules-le-chiffre-stm32/
  - name: le-broke
    url: https://github.com/hahahakeebs/zmk-le-broke/
    revision: main
    path: modules-le-broke/
  - name: zmk-jlw-keyboards
    remote: jlw
    revision: main
  self:
    path: config
```
